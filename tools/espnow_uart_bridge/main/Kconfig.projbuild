## tools/espnow_uart_bridge/main/Kconfig.projbuild
```kconfig
menu "ESP-NOW UART Bridge"

config BRIDGE_ROLE_AIR
    bool "Build air-side bridge"
    default n
    help
        Air side connects the XIAO external UART pins to Pico UART0.
        Ground side receives ESP-NOW packets and writes them to USB serial.

config BRIDGE_UART_BAUD
    int "External UART baud"
    default 2000000

config BRIDGE_WIFI_CHANNEL
    int "ESP-NOW Wi-Fi channel"
    range 1 13
    default 1

config BRIDGE_PEER_MAC
    string "ESP-NOW peer station MAC address"
    default "38:44:be:a4:15:b8" if BRIDGE_ROLE_AIR
    default "38:44:be:a4:06:bc"
    help
        Unicast ESP-NOW peer MAC. The air image points at the ground XIAO,
        and the ground image points at the air XIAO.

config BRIDGE_AUTO_LEARN_PEER
    bool "Learn peer MAC from first valid bridge packet"
    default y
    help
        Learn the ESP-NOW peer from the first packet with valid bridge magic,
        role, length, and CRC. This is useful when USB/JTAG serial labels do
        not match the Wi-Fi STA MAC used by ESP-NOW. Disable this for a
        fixed-peer deployment where BRIDGE_PEER_MAC is known to be the STA MAC.

config BRIDGE_PACKET_PAYLOAD_MAX
    int "Maximum ESP-NOW bridge payload bytes per packet"
    range 1 237
    default 237
    help
        Payload bytes carried after the bridge header. The default keeps the
        complete bridge packet under the ESP-NOW v1 packet limit and allows
        the largest MAVLink v1 frame that fits after the bridge header.

config BRIDGE_SEND_TIMEOUT_MS
    int "ESP-NOW send callback timeout in milliseconds"
    range 1 1000
    default 100
    help
        Maximum time the bridge waits for the ESP-NOW send callback after
        esp_now_send returns ESP_OK. A timeout is counted as a send failure so
        a missing callback cannot stop the transmit task permanently.

config BRIDGE_QUEUE_DEPTH
    int "Bridge queue depth"
    range 4 256
    default 192

config BRIDGE_TASK_STACK
    int "Bridge task stack size"
    range 2048 16384
    default 8192

config BRIDGE_CONFIGURE_ESPNOW_RATE
    bool "Configure ESP-NOW peer PHY rate"
    default n
    help
        Leave disabled for first bring-up. Once the unicast bridge is stable,
        enable this to experiment with a fixed ESP-NOW PHY rate.

config BRIDGE_ESPNOW_PHY_RATE
    int "ESP-NOW peer PHY rate enum value"
    default 10
    depends on BRIDGE_CONFIGURE_ESPNOW_RATE
    help
        Numeric wifi_phy_rate_t value. Default 10 is WIFI_PHY_RATE_12M in
        current ESP-IDF headers.

config BRIDGE_UART_TX_GPIO
    int "External UART TX GPIO"
    default 11

config BRIDGE_UART_RX_GPIO
    int "External UART RX GPIO"
    default 12

config BRIDGE_ENABLE_STATS
    bool "Print bridge diagnostics to serial"
    default n
    help
        Print periodic counters to stderr. Leave this disabled when the ground
        side USB serial is carrying a binary protocol such as MAVLink.

config BRIDGE_TEST_PATTERN
    bool "Send periodic test packets from the air bridge"
    default n
    help
        In air builds, send a small ESP-NOW test packet once per second. This
        verifies the ESP-NOW path without requiring the Pico UART to produce
        data. Leave this disabled for binary protocol bridging.

endmenu
```

## tools/espnow_uart_bridge/sdkconfig.defaults
```kconfig
CONFIG_IDF_TARGET="esp32c5"
# CONFIG_ESP_CONSOLE_USB_SERIAL_JTAG is not set
CONFIG_ESP_CONSOLE_NONE=y
# CONFIG_ESP_CONSOLE_SECONDARY_USB_SERIAL_JTAG is not set
CONFIG_ESP_CONSOLE_SECONDARY_NONE=y
CONFIG_LOG_DEFAULT_LEVEL_NONE=y
CONFIG_ESP_SYSTEM_USE_FRAME_POINTER=y
CONFIG_BRIDGE_PACKET_PAYLOAD_MAX=200
CONFIG_BRIDGE_QUEUE_DEPTH=32
CONFIG_BRIDGE_SEND_TIMEOUT_MS=100
CONFIG_BRIDGE_TASK_STACK=8192
# CONFIG_BRIDGE_CONFIGURE_ESPNOW_RATE is not set
CONFIG_ESP_WIFI_STATIC_RX_BUFFER_NUM=16
CONFIG_ESP_WIFI_DYNAMIC_RX_BUFFER_NUM=64
CONFIG_ESP_WIFI_DYNAMIC_TX_BUFFER_NUM=64
CONFIG_ESP_WIFI_TX_BA_WIN=16
CONFIG_ESP_WIFI_RX_BA_WIN=16
```
